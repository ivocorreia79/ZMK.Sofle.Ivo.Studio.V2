/*
 * SPDX-License-Identifier: MIT
 */

 / {
    left_encoder: encoder_left {
        compatible = "alps,ec11";
        a-gpios = <&pro_micro 9  (GPIO_ACTIVE_HIGH | GPIO_PULL_UP)>;
        b-gpios = <&pro_micro 10 (GPIO_ACTIVE_HIGH | GPIO_PULL_UP)>;
        steps = <24>;
        status = "okay";
    };

    sensors {
        compatible = "zmk,keymap-sensors";
        sensors = <&left_encoder>;
        triggers-per-rotation = <24>;
    };
};
