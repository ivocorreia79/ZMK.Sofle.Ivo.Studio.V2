## config/west.yml
```yaml
manifest:
  remotes:
    - name: zmkfirmware
      url-base: https://github.com/zmkfirmware
    - name: cormoran
      url-base: https://github.com/cormoran

  projects:
    # ZMK oficial (obrigatório para urob/zmk-actions)
    - name: zmk
      remote: zmkfirmware
      revision: main
      import: app/west.yml

    # Módulo runtime para encoders via ZMK Studio
    - name: zmk-behavior-runtime-sensor-rotate
      remote: cormoran
      revision: main

  self:
    path: .
```
